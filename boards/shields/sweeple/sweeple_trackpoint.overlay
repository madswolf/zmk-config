/*
 * Copyright (c) 2020 Pete Johanson
 *
 * SPDX-License-Identifier: MIT
 */

#include "split_inputs.dtsi"
#include "sweeple_trackpoint.dtsi"

//#include <input/processors/report_rate_limit.dtsi>
//#include <input/processors/xyz.dtsi>

&trackpoint_split { device = <&mouse_ps2>; };
//&trackpoint_split { device = <&mouse_ps2>; input-processors = <&zip_report_rate_limit 4>, <&zip_xyz>; };