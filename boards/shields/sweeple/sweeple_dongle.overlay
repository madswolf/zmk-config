/*
 * Copyright (c) 2020 The ZMK Contributors
 *
 * SPDX-License-Identifier: MIT
 */

#include "split_inputs.dtsi"
#include "sweeple.dtsi"
#include <input/processors.dtsi>
       
&trackpoint_listener {
    status = "okay";
    input-processors = <&zip_xy_swap_mapper>;
};