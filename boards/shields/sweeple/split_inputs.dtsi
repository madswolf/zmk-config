/*
 * Copyright (c) 2020 Pete Johanson
 *
 * SPDX-License-Identifier: MIT
 */

/{
    split_inputs {
        #address-cells = <1>;
        #size-cells = <0>;
        trackpoint_split: trackpoint_split@0 {
            compatible = "zmk,input-split";
            reg = <0>;
        };
    };
    
    trackpoint_listener: trackpoint_listener {
        compatible = "zmk,input-listener";
        status = "disabled";
        device = <&trackpoint_split>;
    };
};