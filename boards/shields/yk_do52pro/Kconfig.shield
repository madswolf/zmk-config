## boards/shields/yk_do52pro/Kconfig.shield
```kconfig
# Copyright (c) 2020 Pete Johanson
# SPDX-License-Identifier: MIT

config SHIELD_YK_DO52PRO_LEFT
    def_bool $(shields_list_contains,yk_do52pro_left)

config SHIELD_YK_DO52PRO_RIGHT
    def_bool $(shields_list_contains,yk_do52pro_right)
```

## config/west.yml
```yaml
manifest:
  remotes:
    - name: zmkfirmware
      url-base: https://github.com/zmkfirmware
    - name: madswolf
      url-base: https://github.com/madswolf
  projects:
    - name: zmk
      remote: zmkfirmware
      revision: main
      import: app/west.yml

    # Module for PS/2 mouse & TP driver
    - name: kb_zmk_ps2_mouse_trackpoint_driver
      remote: madswolf
      revision: main

  self:
    path: config
```
